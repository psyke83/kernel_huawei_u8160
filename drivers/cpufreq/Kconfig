## drivers/cpufreq/Kconfig
```kconfig
config CPU_FREQ
	bool "CPU Frequency scaling"
	help
	  CPU Frequency scaling allows you to change the clock speed of 
	  CPUs on the fly. This is a nice method to save power, because 
	  the lower the CPU clock speed, the less power the CPU consumes.

	  Note that this driver doesn't automatically change the CPU
	  clock speed, you need to either enable a dynamic cpufreq governor
	  (see below) after boot, or use a userspace tool.

	  For details, take a look at <file:Documentation/cpu-freq>.

	  If in doubt, say N.

if CPU_FREQ

config CPU_FREQ_MIN_FREQ
	int "Minimum CPU Frequency"
	default 245000

config CPU_FREQ_MAX_FREQ
	int "Maximum CPU Frequency"
	default 998400
	help
	  WARNING: Since not all devices are made equal, do not set this higher
	  than the stock frequency.

config CPU_FREQ_TABLE
	tristate

config CPU_FREQ_DEBUG
	bool "Enable CPUfreq debugging"
	help
	  Say Y here to enable CPUfreq subsystem (including drivers)
	  debugging. You will need to activate it via the kernel
	  command line by passing
	     cpufreq.debug=<value>

	  To get <value>, add 
	       1 to activate CPUfreq core debugging,
	       2 to activate CPUfreq drivers debugging, and
	       4 to activate CPUfreq governor debugging

config CPU_FREQ_STAT
	tristate "CPU frequency translation statistics"
	select CPU_FREQ_TABLE
	default y
	help
	  This driver exports CPU frequency statistics information through sysfs
	  file system.

	  To compile this driver as a module, choose M here: the
	  module will be called cpufreq_stats.

	  If in doubt, say N.

config CPU_FREQ_STAT_DETAILS
	bool "CPU frequency translation statistics details"
	depends on CPU_FREQ_STAT
	help
	  This will show detail CPU frequency translation table in sysfs file
	  system.

	  If in doubt, say N.

choice
	prompt "Default CPUFreq governor"
	default CPU_FREQ_DEFAULT_GOV_USERSPACE if CPU_FREQ_SA1100 || CPU_FREQ_SA1110
	default CPU_FREQ_DEFAULT_GOV_PERFORMANCE
	help
	  This option sets which CPUFreq governor shall be loaded at
	  startup. If in doubt, select 'performance'.

config CPU_FREQ_DEFAULT_GOV_PERFORMANCE
	bool "performance"
	select CPU_FREQ_GOV_PERFORMANCE
	help
	  Use the CPUFreq governor 'performance' as default. This sets
	  the frequency statically to the highest frequency supported by
	  the CPU.

config CPU_FREQ_DEFAULT_GOV_POWERSAVE
	bool "powersave"
	depends on EMBEDDED
	select CPU_FREQ_GOV_POWERSAVE
	help
	  Use the CPUFreq governor 'powersave' as default. This sets
	  the frequency statically to the lowest frequency supported by
	  the CPU.

config CPU_FREQ_DEFAULT_GOV_USERSPACE
	bool "userspace"
	select CPU_FREQ_GOV_USERSPACE
	help
	  Use the CPUFreq governor 'userspace' as default. This allows
	  you to set the CPU frequency manually or when a userspace 
	  program shall be able to set the CPU dynamically without having
	  to enable the userspace governor manually.

config CPU_FREQ_DEFAULT_GOV_ONDEMAND
	bool "ondemand"
	select CPU_FREQ_GOV_ONDEMAND
	select CPU_FREQ_GOV_PERFORMANCE
	help
	  Use the CPUFreq governor 'ondemand' as default. This allows
	  you to get a full dynamic frequency capable system by simply
	  loading your cpufreq low-level hardware driver.
	  Be aware that not all cpufreq drivers support the ondemand
	  governor. If unsure have a look at the help section of the
	  driver. Fallback governor will be the performance governor.

config CPU_FREQ_DEFAULT_GOV_CONSERVATIVE
	bool "conservative"
	select CPU_FREQ_GOV_CONSERVATIVE
	select CPU_FREQ_GOV_PERFORMANCE
	help
	  Use the CPUFreq governor 'conservative' as default. This allows
	  you to get a full dynamic frequency capable system by simply
	  loading your cpufreq low-level hardware driver.
	  Be aware that not all cpufreq drivers support the conservative
	  governor. If unsure have a look at the help section of the
	  driver. Fallback governor will be the performance governor.

config CPU_FREQ_DEFAULT_GOV_INTERACTIVE
	bool "interactive"
	select CPU_FREQ_GOV_INTERACTIVE
	help
	 Use the 'interactive' governor as default. This gets full cpu frequency
	 scaling for workloads that are latency sensitive, typically interactive
	 workloads..
config CPU_FREQ_DEFAULT_GOV_SMARTASS
  bool "smartass"
  select CPU_FREQ_GOV_SMARTASS
  select CPU_FREQ_GOV_PERFORMANCE
  help
    Use the CPUFreq governor 'smartass' as default.

 endchoice
 
config CPU_FREQ_GOV_SMARTASS
  tristate "'smartass' cpufreq governor"
  depends on CPU_FREQ
  help
    'smartass' - a "smart" optimized governor for the hero!

    If in doubt, say N.

config SMARTASS_SLEEP_MAX
	int "Sleep Max Freq"
	default 245000
	depends on CPU_FREQ_GOV_SMARTASS
	help
	  When sleep_max_freq>0 the frequency when suspended will be capped
	  by this frequency. Also will wake up at max frequency of policy
	  to minimize wakeup issues.
	  Set sleep_max_freq=0 to disable this behavior.

config SMARTASS_SLEEP_WAKEUP
	int "Sleep Wakeup Freq"
	default CPU_FREQ_MAX_FREQ
	depends on CPU_FREQ_GOV_SMARTASS
	help
	  The frequency to set when waking up from sleep.
	  When sleep_max_freq=0 this will have no effect.

config SMARTASS_DEFAULT_SAMPLE_RATE_JIFFIES
	int "Default sample rate jiffies"
	default 2
	depends on CPU_FREQ_GOV_SMARTASS
	help
	  Sampling rate, I highly recommend to leave it at 2.

config SMARTASS_DEFAULT_RAMP_UP_STEP
	int "Default ramp up step"
	default 38400
	depends on CPU_FREQ_GOV_SMARTASS
	help
	  Freqeuncy delta when ramping up.
	  zero disables causes to always jump straight to max frequency.

config SMARTASS_DEFAULT_MAX_RAMP_DOWN
	int "Default ramp down step"
	default 38400
	depends on CPU_FREQ_GOV_SMARTASS
	help
	  Max freqeuncy delta when ramping down. zero disables.

config SMARTASS_DEFAULT_IGNORE_STEP_FREQ
	int "Ignore stepping freq"
	default 245000
	depends on CPU_FREQ_GOV_SMARTASS
	help
	  Ignore up and down steps at or below this frequency.
	  Default is 245000

config SMARTASS_DEFAULT_MAX_CPU_LOAD
	int "Default max cpu load"
	default 80
	depends on CPU_FREQ_GOV_SMARTASS
	help
	  CPU freq will be increased if measured load > max_cpu_load;

config SMARTASS_DEFAULT_MIN_CPU_LOAD
	int "Default min cpu load"
	default 30
	depends on CPU_FREQ_GOV_SMARTASS
	help
	  CPU freq will be decreased if measured load < min_cpu_load;

config SMARTASS_DEFAULT_DOWN_RATE_US
	int "Default down rate in us"
	default 45
	depends on CPU_FREQ_GOV_SMARTASS
	help
	  The minimum amount of time to spend at a frequency before we can ramp down,
	  default is 45ms

config SMARTASS_DEFAULT_UP_MIN_FREQ
	int "Default up minimum frequency"
	default CPU_FREQ_MAX_FREQ
	depends on CPU_FREQ_GOV_SMARTASS
	help
	  When ramping up frequency with no idle cycles jump to at least this frequency.
	  Zero disables. Set a very high value to jump to policy max freqeuncy.

config CPU_FREQ_GOV_PERFORMANCE
	tristate "'performance' governor"
	help
	  This cpufreq governor sets the frequency statically to the
	  highest available CPU frequency.

	  To compile this driver as a module, choose M here: the
	  module will be called cpufreq_performance.

	  If in doubt, say Y.

config CPU_FREQ_GOV_POWERSAVE
	tristate "'powersave' governor"
	help
	  This cpufreq governor sets the frequency statically to the
	  lowest available CPU frequency.

	  To compile this driver as a module, choose M here: the
	  module will be called cpufreq_powersave.

	  If in doubt, say Y.

config CPU_FREQ_GOV_USERSPACE
	tristate "'userspace' governor for userspace frequency scaling"
	help
	  Enable this cpufreq governor when you either want to set the
	  CPU frequency manually or when a userspace program shall
	  be able to set the CPU dynamically, like on LART 
	  <http://www.lartmaker.nl/>.

	  To compile this driver as a module, choose M here: the
	  module will be called cpufreq_userspace.

	  For details, take a look at <file:Documentation/cpu-freq/>.

	  If in doubt, say Y.

config CPU_FREQ_GOV_ONDEMAND
	tristate "'ondemand' cpufreq policy governor"
	select CPU_FREQ_TABLE
	help
	  'ondemand' - This driver adds a dynamic cpufreq policy governor.
	  The governor does a periodic polling and 
	  changes frequency based on the CPU utilization.
	  The support for this governor depends on CPU capability to
	  do fast frequency switching (i.e, very low latency frequency
	  transitions). 

	  To compile this driver as a module, choose M here: the
	  module will be called cpufreq_ondemand.

	  For details, take a look at linux/Documentation/cpu-freq.

	  If in doubt, say N.

config CPU_FREQ_GOV_ONDEMAND_INPUT
	bool "Ramp up CPU frequency on input events"
	default y
	depends on CPU_FREQ_GOV_ONDEMAND
	help
	  Enable installation of an input event handler which will ramp up the
	  CPU to max frequency when an input event is received.

config CPU_FREQ_GOV_INTERACTIVE
	tristate "'interactive' cpufreq policy governor"
	help
	 'interactive' - This driver adds a dynamic cpufreq policy governor.
	 Designed for low latency burst workloads. Scaling it done when coming
	 out of idle instead of polling.

config CPU_FREQ_GOV_CONSERVATIVE
	tristate "'conservative' cpufreq governor"
	depends on CPU_FREQ
	help
	  'conservative' - this driver is rather similar to the 'ondemand'
	  governor both in its source code and its purpose, the difference is
	  its optimisation for better suitability in a battery powered
	  environment.  The frequency is gracefully increased and decreased
	  rather than jumping to 100% when speed is required.

	  If you have a desktop machine then you should really be considering
	  the 'ondemand' governor instead, however if you are using a laptop,
	  PDA or even an AMD64 based computer (due to the unacceptable
	  step-by-step latency issues between the minimum and maximum frequency
	  transitions in the CPU) you will probably want to use this governor.

	  To compile this driver as a module, choose M here: the
	  module will be called cpufreq_conservative.

	  For details, take a look at linux/Documentation/cpu-freq.

	  If in doubt, say N.

config CPU_FREQ_VDD_LEVELS
	bool "CPU Vdd levels sysfs interface"
	depends on CPU_FREQ_STAT
	depends on ARCH_QSD8X50
	default n
	help
	  CPU Vdd levels sysfs interface

config CPU_FREQ_VDD_LEVELS_MIN
	int "Min VDD Level"
	default 1000

config CPU_FREQ_VDD_LEVELS_MAX
	int "Max VDD Level"
	default 1300

endif	# CPU_FREQ
```

## drivers/huawei/Kconfig
```kconfig
#
# HUAWEI OWN CONFIG
#

menuconfig HUAWEI_APPS
	tristate "Huawei Configuration"
	default y
	help
		if Y , select CONFIG_HUAWEI_APPS  

if HUAWEI_APPS
config HUAWEI_FEATURE_BSP
	tristate "Huawei bsp feature"	
	default y
	help
	  if Y ,select HUAWEI_FEATURE_BSP  

config	HUAWEI_FEATURE_DEBUG
	tristate "huawei debug feature"
	default n
	help
	  if Y ,select HUAWEI_FEATURE_DEBUG, when release vesion , comment  HUAWEI_FEATURE_U8220_DEBUG	  	  	  
config DIAG_ON_UART3
        tristate "Diag on uart3"
	default n
	help
	  if Y, select CONFIG_DIAG_ON_UART3, Support for Diag service on Arm11 Uart3.


config HUAWEI_STEREO_HEADSET
	tristate "Stereo headset is used"
	default n
	help
	  if Y ,select HUAWEI_STEREO_HEADSET

config HUAWEI_SMI_64M
	tristate "Stereo headset is used"
	default n
	help
	  if Y ,select HUAWEI_SMI_64M, this supprot 64M smi 
config HUAWEI_SHARE_MEMORY_DEVICE
	bool "huawei share memory device, used to communicate with arm 9"
	depends on HUAWEI_KERNEL=y
	default y
	help
	  Say Y here if you want support for share memory device support.

config HUAWEI_FACTORY_RECOVERY
	tristate "Android Factory Recovery is used"
	default n
	help
	  if Y ,select Android Factory Recovery, and support Wipe userdata and cache flash partitions

config HUAWEI_USB_FUNCTION
	tristate "Utilize Huawei USB PID&VID"
	default n
	help
	  if Y ,select HUAWEI_USB_FUNCTION, this supprot Huawei USB PID&VID	  	  	  

config	HUAWEI_FEATURE_U8220_T2
	tristate "huawei T2 feature"
	default n
	help
	  if Y ,select HUAWEI_FEATURE_U8220_T2, this supprot Huawei T2 Hardware modifiction	  	  	  

config	HUAWEI_FEATURE_U8220_PRODUCTION
	tristate "huawei production feature"
	default n
	help
	  if Y ,select HUAWEI_FEATURE_U8220_PRODUCTION, when product ,open this feature

config	HUAWEI_USB_SERIAL
	tristate "huawei USB Serial number"
	default n
	help
	  if Y ,select HUAWEI_USB_SERIAL, The phone use the identify Serial number

config	HUAWEI_ACPU_CLOCK
	tristate "huawei Acpu clock table"
	default n
	help
	  if Y ,select HUAWEI_ACPU_CLOCK, this will reset acpu clock table

config	HUAWEI_NV_LOG_CONTROL
	tristate "huawei nv log table"
	default n
	help
	  if Y ,select HUAWEI_NV_LOG_CONTROL, this will store log_enabl and log_priority in nv item

config	HUAWEI_FEATURE_U8220_PP1
	tristate "huawei pp1 feature"
	default n
	help
	  if Y ,select HUAWEI_FEATURE_U8220_PP1, this supprot Huawei PP1 Hardware modifiction	  	  	  

config	HUAWEI_CRASH_DUMP
	tristate "huawei crash dump"
	depends on  HUAWEI_FEATURE_DEBUG
	default n
	help
	  if Y ,select HUAWEI_CRASH_DUMP, this will dump crash infomation to memory

config	HUAWEI_FEATURE_U8220_BLUETOOTH
	tristate "huawei bluetooth sleep modification"
	default n
	help
	  if Y ,select HUAWEI_FEATURE_U8220_BLUETOOTH, this will alloc a wakelock when work , when uart sleep then release 

config HUAWEI_DIAG_DEBUG
	tristate "huawei diag debug"
	depends on  HUAWEI_FEATURE_DEBUG
	default n
	help
	  if Y ,select HUAWEI_DIAG_DEBUG, diag port will enable

config HUAWEI_USB_CONSOLE
	tristate "huawei usb console"
	depends on  HUAWEI_FEATURE_DEBUG
	default n
	help
	  if Y ,select HUAWEI_USB_CONSOLE, usb_console port will enable

config HUAWEI_USB_PID_GENERAL_RELEASE
	tristate "huawei general release"
	default n
	help
	  if Y ,select HUAWEI_USB_PID_GENERAL_RELEASE, select USB pid general release product

config HUAWEI_USB_FUNCTION_PCUI
	tristate "huawei usb function pcui"
	default n
	help
	  if Y ,select HUAWEI_USB_PID_GENERAL_RELEASE, select USB pid general release product
	  
config HUAWEI_BACK_KEY_MULTI
	bool "huawei back key multi"
	depends on HUAWEI_KERNEL=y
	default n
	help
	  Say Y here if you want support for huawei back key multi

config HUAWEI_FOTA_UPDATA
	tristate "fota updata"
	default n
	help
	  if Y ,select HUAWEI_FOTA_UPDATA, this supprot fota updata

config USB_AUTO_INSTALL
	bool "usb auto install"
	default n
	help
	  if Y ,select USB_AUTO_INSTALL

endif
```
