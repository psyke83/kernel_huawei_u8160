## drivers/i2c/chips/Kconfig
```kconfig
#
# Miscellaneous I2C chip drivers configuration
#
# *** DEPRECATED! Do not add new entries! See Makefile ***
#

menu "Miscellaneous I2C Chip support"

config DS1682
	tristate "Dallas DS1682 Total Elapsed Time Recorder with Alarm"
	depends on EXPERIMENTAL
	help
	  If you say yes here you get support for Dallas Semiconductor
	  DS1682 Total Elapsed Time Recorder.

	  This driver can also be built as a module.  If so, the module
	  will be called ds1682.

config SENSORS_TSL2550
	tristate "Taos TSL2550 ambient light sensor"
	depends on EXPERIMENTAL
	help
	  If you say yes here you get support for the Taos TSL2550
	  ambient light sensor.

	  This driver can also be built as a module.  If so, the module
	  will be called tsl2550.
config SENSORS_AKM8973
	tristate "AKM8973 Compass Driver"
	depends on I2C
	help
	 AKM8973 Compass Driver implemented by HTC.

config  UPDATE_COMPASS_FIRMWARE
        depends on HUAWEI_FEATURE_DEBUG
	default n
        bool "update akm8973 compass firmware"
        help
          Say Y here if you want to update akm8973 compass firmware 
config SENSORS_AKM8976
	tristate "AKM8976 Compass Driver"
	depends on I2C
	help
	 AKM8976 Compass Driver implemented by HTC.

config SENSORS_AKM8973
	tristate "AKM8973 Compass Driver"
	depends on I2C
	help
	 AKM8973 Compass Driver implemented by HTC.

config SENSORS_PCA963X
	tristate "Philips PCA963X 4-bit I2C-bus LED"
	depends on I2C && EXPERIMENTAL
	help
	 If you say yes here you get support for the Philips PCA963X
	 4-bit I2C-bus LED.

	 This driver can also be built as a module.  If so, the module
	 will be called pca963X.

config SENSORS_MT9T013
	tristate "MT9T013 Camera Driver"
	depends on I2C
	default y
	help
	 MT9T013 Camera Driver implemented by HTC.

config VP_A1026
	tristate "A1026 Voice Processor Driver"
	depends on I2C
	help
	  A1026 Voice Processor Driver implemented by HTC.
config QWERTY_KEYPAD_ADP5587
	tristate "Qwerty Keypad Controller Driver"
	depends on I2C
	default y
	help
	 Driver for Qwerty Keypad Controller Driver.
config SENSORS_ST_LSM303DLH
	tristate "LSM303DLH is a 6D sensors(gs&ms)"
	depends on HUAWEI_KERNEL
	default y
	help
	 The LSM303DLH is a system-in-package featuring a 3D
	 digital linear acceleration sensor and a 3D digital magnetic sensor.

config SENSORS_AK8975
	tristate "AK8975"
	depends on HUAWEI_KERNEL
	default n
	help
	  If you say yes here you get support for Asahi Kasei's 
	  orientation sensor AK8975.

endmenu
```

## drivers/input/accelerometer/Kconfig
```kconfig
#
# accelerometer driver configuration
#
menuconfig INPUT_ACCELEROMETER
	bool "Accelerometer"
	help
	  Say Y here, and a list of supported ACCELEROMETERs will be displayed.
	  This option doesn't affect the kernel.

	 

if INPUT_ACCELEROMETER

config ACCELEROMETER_ADXL345
	tristate "ADI ADXL345 accelerometer"	
	select SERIO
	help
	  Say Y here if you have the ADXL345 accelerometer.

	  
config ACCELEROMETER_ST_L1S35DE
	tristate "ST LIS35DE accelerometer"	
	select SERIO
	help
	  Say Y here if you have the ST LIS35DE accelerometer.

config ACCELEROMETER_ADI_ADXL346
	tristate "ADI ADXL346 accelerometer"
	select SERIO
	help
	  Say Y here if you have the ADI ADXL346 accelerometer.

config ACCELEROMETER_ST_LIS3XH
	tristate "ST LIS3DH and LIS331DLH accelerometer"	
	select SERIO
	help
	  Say Y here if you have the ST LIS3DH and LIS331DLH accelerometer.


config ACCELEROMETER_MMA7455L
        tristate "FREESCALE MMA7455L accelerometer"
	select SERIO
	help
	  Say Y here if you have the FREESCALE MMA7455L accelerometer.
endif

config ACCELEROMETER_MMA8452
	tristate "FREESCALE MMA8452 accelerometer"
	select SERIO
	help
	  Say Y here if you have the FREESCALE MMA8452 accelerometer.

config ACCELEROMETER_BOSCH_BMA250
	tristate "BOSCH BMA250 accelerometer"
	select SERIO
	help
	  Say Y here if you have the BOSCH BMA250 accelerometer.
	  
```

## drivers/media/video/msm/Kconfig
```kconfig
comment "Camera Sensor Selection"
config MT9T013
	bool "Sensor mt9t013 (BAYER 3M)"
	depends on MSM_CAMERA
	default y
	---help---
	  MICRON 3M Bayer Sensor with AutoFocus

config MT9D112
	bool "Sensor mt9d112 (YUV 2M)"
	depends on MSM_CAMERA
	default y
	---help---
	  MICRON 2M YUV Sensor
config VX6953
	bool "Sensor VX6953 (BAYER 5M)"
	depends on MSM_CAMERA && ARCH_MSM7X30
	default y
	---help---
	STM 5M Bayer Sensor with EDOF

config MT9P012
	bool "Sensor mt9p012 (BAYER 5M)"
	depends on MSM_CAMERA
	default y
	---help---
	  MICRON 5M Bayer Sensor with Autofocus

choice
	prompt "AF module"
	depends on MT9P012
	default MSM_CAMERA_AF_FOXCONN

config MSM_CAMERA_AF_FOXCONN
	bool "FOXCONN Module"
	help
	  This driver supports FOXCONN AF module for 5M Bayer sensor

config MSM_CAMERA_AF_BAM
	bool "BAM Module"
	help
	  This driver supports BAM AF module for 5M Bayer sensor

endchoice

config MT9P012_KM
	bool "Sensor mt9p012 KM module (BAYER 5M)"
	depends on MSM_CAMERA
	default y
	---help---
	  MICRON 5M Bayer Sensor KM modules with Autofocus

config S5K3E2FX
	bool "Sensor s5k3e2fx (Samsung 5M)"
	depends on MSM_CAMERA
	default y
	---help---
	  Samsung 5M with Autofocus

config VB6801
	bool "Sensor vb6801"
	depends on MSM_CAMERA
	---help---
	  5M with flash

config MSM_CAMERA_FLASH
	bool "Qualcomm MSM camera flash support"
	depends on MSM_CAMERA
	default y
	---help---
	  Enable support for LED flash for msm camera

config MSM_GEMINI
	tristate "Qualcomm MSM Gemini Jpeg Engine support"
	depends on MSM_CAMERA
	default M
	---help---
	  Enable support for Gemini Jpeg Engine


config HUAWEI_CAMERA
	bool "huawei sensor"
	default n
	---help---
	  MICRON 2M YUV Sensor

config HUAWEI_CAMERA_SENSOR_OV3647
	tristate "ov3647 is used"
	default n
	help
	  if Y ,select HUAWEI_CAMERA_SENSOR_OV3647
	  
config HUAWEI_CAMERA_SENSOR_OV7690
	tristate "ov7690 is used"
	default n
	help
	if Y ,select HUAWEI_CAMERA_SENSOR_OV7690
	
config HUAWEI_CAMERA_SENSOR_HIMAX0356
	tristate "himax0356 is used"
	default n
	help
	if Y ,select HUAWEI_CAMERA_SENSOR_HIMAX0356
	
config HUAWEI_CAMERA_SENSOR_MT9D113
	tristate "mt9d113 is used"
	default n
	help
	if Y ,select HUAWEI_CAMERA_SENSOR_MT9D113

config HUAWEI_CAMERA_SENSOR_S5K5CA
	tristate "s5k5ca is used"
	default n
	help
	if Y ,select HUAWEI_CAMERA_SENSOR_S5K5CA

config HUAWEI_CAMERA_SENSOR_S5K4CDGX
	tristate "s5k4cdgx is used"
	default n
	help
	if Y ,select HUAWEI_CAMERA_SENSOR_S5K4CDGX

config HUAWEI_CAMERA_SENSOR_HI253
	tristate "hi253 is used"
	default n
	help
	if Y ,select HUAWEI_CAMERA_SENSOR_HI253
```

## drivers/staging/ramzswap/Kconfig
```kconfig
config RAMZSWAP
	tristate "Compressed swap (ramzswap) support"
	depends on SWAP && CRYPTO_LZO
	default n
	---help---
	  This will build the compressed swap (ramzswap) module
```

## drivers/staging/zram/Kconfig
```kconfig
config ZRAM
	tristate "Compressed swap (zram) support"
	depends on SWAP && CRYPTO_LZO
	default n
	---help---
	  This will build the compressed swap (zram) module
```
